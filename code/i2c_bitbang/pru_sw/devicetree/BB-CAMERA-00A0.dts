/*
 * Copyright (C) 2013 CircuitCo
 *
 * Virtual cape for UART1 on connector pins P9.24 P9.26
 *
 * This program is free software; you can redistribute it and/or modify
 * it under the terms of the GNU General Public License version 2 as
 * published by the Free Software Foundation.
 */
/dts-v1/;
/plugin/;

/ {
	compatible = "ti,beaglebone", "ti,beaglebone-black";

	/* identification */
	part-number = "BB-CAMERA";
	version = "00A0";

	/* state the resources this cape uses */
	exclusive-use =
		/* the pin header uses */
	        "P8.46",
        	"P8.45",
	        "P8.44",
	        "P8.43",
	        "P8.42",
	        "P8.41",
	        "P8.40",
	        "P8.39",
	        "P9.26",
		"P8.27",
		"P8.29",
		"P9.31",
		"P9.30", 
		"P9.29", 
		"P9.28", 
		"P8.28",
		"P8.30",
		"P9.25",

		/* the hardware ip uses */
		"pruss";

	fragment@0 {
		target = <&am33xx_pinmux>;
		__overlay__ {
			bb_uart1_pins: pinmux_bb_uart1_pins {
				pinctrl-single,pins = <
					0x0a4 0x2e
					0x0a0 0x2e
					0x0ac 0x2e
					0x0a8 0x2e
					0x0b4 0x2e
					0x0b0 0x2e
					0x0bc 0x2e
					0x0b8 0x2e
					0x180 0x2e

					0x0e0 0x0d
					0x0e4 0x0d
					0x0e8 0x0d
					0x0ec 0x0d
					
					0x190 0x05
					0x198 0x05
					0x194 0x05
					0x19c 0x05
					0x1ac 0x26
				>;
			};
		};
	};

	fragment@1 {
		target = <&uart2>;	/* really uart1 */
		__overlay__ {
			status = "okay";
			pinctrl-names = "default";
			pinctrl-0 = <&bb_uart1_pins>;
		};
	};
};
